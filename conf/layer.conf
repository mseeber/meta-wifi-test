## conf/layer.conf
```bitbake
# We have a conf and classes directory, add to BBPATH
BBPATH .= ":${LAYERDIR}"

# We have recipes-* directories, add to BBFILES
BBFILES += "${LAYERDIR}/recipes-*/*/*.bb \
            ${LAYERDIR}/recipes-*/*/*.bbappend"

BBFILE_COLLECTIONS += "meta-wifi-test"
BBFILE_PATTERN_meta-wifi-test = "^${LAYERDIR}/"
BBFILE_PRIORITY_meta-wifi-test = "6"

LAYERDEPENDS_meta-wifi-test = "core"
LAYERSERIES_COMPAT_meta-wifi-test = "kirkstone"
```
